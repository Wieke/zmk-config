## config/boards/shields/test/Kconfig.defconfig
```kconfig
config ZMK_BLE
	default y

config ZMK_USB
	default y

if SHIELD_TEST

config ZMK_KEYBOARD_NAME
    default "Test"

endif
```

## config/west.yml
```yaml
manifest:
  remotes:
    - name: zmkfirmware
      url-base: https://github.com/zmkfirmware
    - name: wieke
      url-base: https://github.com/wieke
  projects:
    - name: zmk
      remote: wieke
      revision: main
      import: app/west.yml
  self:
    path: config
```
