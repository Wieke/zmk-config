#include "test.dtsi" 

&kscan0 {
	col-gpios
		= <&pro_micro 7 GPIO_ACTIVE_HIGH>
		, <&pro_micro 8 GPIO_ACTIVE_HIGH>
		, <&pro_micro 9 GPIO_ACTIVE_HIGH>
		;
};

&pro_micro_i2c {
	status = "okay";
	trackball_pim447@a {
		compatible = "pimoroni,trackball_pim447";
		reg = <0xa>;
		label = "TRACKBALL_PIM447";
	};
};
