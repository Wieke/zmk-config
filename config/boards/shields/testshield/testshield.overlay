/ {
    chosen {
        zmk,kscan = &kscan0;
    };

    kscan0: kscan_0 {
        compatible = "zmk,kscan-gpio-matrix";
        label = "KSCAN";
        diode-direction = "col2row";

        col-gpios
            = <&gpio1 00 GPIO_ACTIVE_HIGH>
            , <&gpio0 11 GPIO_ACTIVE_HIGH>
            ;

        row-gpios
            = <&gpio1 04 (GPIO_ACTIVE_HIGH | GPIO_PULL_DOWN)>
            , <&gpio1 06 (GPIO_ACTIVE_HIGH | GPIO_PULL_DOWN)>
            ;
    };
};
